## conf/machine/xpeedc.conf
```bitbake
#@TYPE: Machine
#@NAME: xpeedc
#@DESCRIPTION: Machine configuration for the xpeedc

MACHINE_FEATURES += " textlcd dvb-c xpeedc-nextv-blindscan-dvbc HDMI RCA"
DISTRO_FEATURES_remove = "x11 wayland directfb"

MKUBIFS_ARGS = "-m 2048 -e 126976 -c 8192"
UBINIZE_ARGS = "-m 2048 -p 128KiB"

CHIPSET = "bcm7362"

PREFERRED_VERSION_linux-xpeedc-nextv = "4.1.21"
require conf/machine/include/xpeedc-nextv-mipsel.inc

RCNAME = "gi1"

BOX_BRAND = "ultramini"

MTD_KERNEL = "mtd1"
MTD_ROOTFS = "mtd2"

SOC_FAMILY = "bcm7362"

KERNEL_FILE = "kernel.bin"
ROOTFS_FILE = "rootfs.bin"

RCTYPE = "504"
```
